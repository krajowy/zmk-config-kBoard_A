## boards/shields/kBoard_A/Kconfig.defconfig
```kconfig
# Copyright (c) 2022 The ZMK Contributors
# SPDX-License-Identifier: MIT

if SHIELD_KBOARD_A

config ZMK_KEYBOARD_NAME
    default "kBoard_A"

endif
```

## boards/shields/kBoard_A/Kconfig.shield
```kconfig
# Copyright (c) 2022 The ZMK Contributors
# SPDX-License-Identifier: MIT

config SHIELD_KBOARD_A
    def_bool $(shields_list_contains,kBoard_A)
```
